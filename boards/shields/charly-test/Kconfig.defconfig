## boards/shields/charly-test/Kconfig.defconfig
```kconfig
if SHIELD_DONGLETEST_R

config ZMK_KEYBOARD_NAME
    default "dongle-test"

config ZMK_SPLIT_ROLE_CENTRAL
    default y

endif

if SHIELD_DONGLETEST_L || SHIELD_DONGLETEST_R

config ZMK_SPLIT
    default y

endif
```

## boards/shields/charly-test/Kconfig.shield
```kconfig
config SHIELD_DONGLETEST_R
    def_bool $(shields_list_contains,dongle-test_r)

config SHIELD_DONGLETEST_L
    def_bool $(shields_list_contains,dongle-test_l)
```

## boards/shields/dongle-test/Kconfig.defconfig
```kconfig
if SHIELD_DONGLETEST_NUM

config ZMK_KEYBOARD_NAME
    default "dongle-test_num"

config ZMK_SPLIT
    default y

config ZMK_SPLIT_ROLE_CENTRAL
    default y

endif

if SHIELD_DONGLETEST_L

config ZMK_KEYBOARD_NAME
    default "dongle-test_l"

config ZMK_SPLIT
    default y

endif

if SHIELD_DONGLETEST_R

config ZMK_KEYBOARD_NAME
    default "dongle-test_r"

config ZMK_SPLIT
    default y

endif
```

## config/west.yml
```yaml
manifest:
  remotes:
    - name: zmkfirmware
      url-base: https://github.com/zmkfirmware
    - name: KATATHY-ZMK
      url-base: https://github.com/KATACY-ZMK
    - name: caksoylar  # <-- RGB LED
      url-base: https://github.com/caksoylar  
    - name: inorichi
      url-base: https://github.com/inorichi
  projects:
    - name: zmk
      remote: zmkfirmware
      revision: main
      import: app/west.yml
    - name: zmk-pmw3610-driver
      remote: inorichi
      revision: main
  self:
    path: config
```
